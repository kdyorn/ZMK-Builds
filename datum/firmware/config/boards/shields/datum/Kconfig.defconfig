## datum/firmware/config/boards/shields/datum/Kconfig.defconfig
```kconfig
if SHIELD_DATUM_LEFT || SHIELD_DATUM_RIGHT || SHIELD_DATUM_DONGLE

config ZMK_KEYBOARD_NAME
    default "Datum"

config ZMK_SPLIT
    default y

config ZMK_SPLIT_BLE
    default y

if SHIELD_DATUM_DONGLE
config ZMK_SPLIT_ROLE_CENTRAL
    default y
endif

endif
```

## datum/firmware/config/boards/shields/datum/Kconfig.shield
```kconfig
config SHIELD_DATUM_LEFT
    def_bool $(shields_list_contains,datum_left)

config SHIELD_DATUM_RIGHT
    def_bool $(shields_list_contains,datum_right)

config SHIELD_DATUM_DONGLE
    def_bool $(shields_list_contains,datum_dongle)
```

## dissect/firmware/config/boards/shields/dissect/Kconfig.defconfig
```kconfig
if SHIELD_DISSECT_LEFT || SHIELD_DISSECT_RIGHT || SHIELD_DISSECT_DONGLE

config ZMK_KEYBOARD_NAME
    default "Dissect"

config ZMK_SPLIT
    default y

config ZMK_SPLIT_BLE
    default y

if SHIELD_DISSECT_DONGLE
config ZMK_SPLIT_ROLE_CENTRAL
    default y
endif

endif
```

## dissect/firmware/config/boards/shields/dissect/Kconfig.shield
```kconfig
config SHIELD_DISSECT_LEFT
    def_bool $(shields_list_contains,dissect_left)

config SHIELD_DISSECT_RIGHT
    def_bool $(shields_list_contains,dissect_right)

config SHIELD_DISSECT_DONGLE
    def_bool $(shields_list_contains,dissect_dongle)
```
