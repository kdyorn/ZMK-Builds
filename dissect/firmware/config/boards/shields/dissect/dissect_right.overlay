#include "dissect.dtsi"

/ {
    chosen {
        zmk,kscan = &kscan0;
        zmk,matrix_transform = &default_transform;
    };
};

&default_transform {
    col-offset = <7>;
};

&kscan0 {
    col-gpios
        = <&gpio1 4  (GPIO_ACTIVE_HIGH)>
        , <&gpio1 6  (GPIO_ACTIVE_HIGH)>
        , <&gpio0 9  (GPIO_ACTIVE_HIGH)>
        , <&gpio0 10 (GPIO_ACTIVE_HIGH)>
        , <&gpio1 11 (GPIO_ACTIVE_HIGH)>
        , <&gpio1 13 (GPIO_ACTIVE_HIGH)>
        , <&gpio1 15 (GPIO_ACTIVE_HIGH)>
        , <&gpio0 2  (GPIO_ACTIVE_HIGH)>
        , <&gpio0 29 (GPIO_ACTIVE_HIGH)>
        ;
};